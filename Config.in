## Config.in
```kconfig
config DPACK_ASSERT_API
	bool "API assertion"
	default n
	help
	  Build dpack library with high-level API assertions enabled to ensure
	  that API functions exposed by DPack will perform full verification of
	  arguments consistency.

config DPACK_ASSERT_INTERN
	bool "Internal assertion"
	select DPACK_ASSERT_API
	default n
	help
	  Build dpack library with internal assertions enabled to check for
	  internal DPack behavioral consistency.

config DPACK_DEBUG
	bool "Debug"
	select DPACK_ASSERT_API
	select DPACK_ASSERT_INTERN
	default n
	help
	  Build dpack library with internal debugging support enabled.
	  This also enables mpack internal debug support with the following
	  additional features:
	  - reading / writing to / from STDIO files,
	  - error strings,
	  - custom dpack / mpack assertions,
	  - reader / writer tracking.

config DPACK_SCALAR
	bool "Scalars"
	default y
	help
	  Build dpack library with scalar support allowing to (de)serialize,
	  boolean, signed and unsigned integers.

config DPACK_FLOAT
	bool "Single precision floating point numbers"
	depends on DPACK_SCALAR
	default n
	help
	  Build dpack library with single precision floating point number
	  support allowing to (de)serialize floats.

config DPACK_DOUBLE
	bool "Double precision floating point numbers"
	depends on DPACK_SCALAR
	default n
	help
	  Build dpack library with double precision floating point number
	  support allowing to (de)serialize doubles.

config DPACK_STRING
	bool "Strings"
	default y
	help
	  Build dpack library with string support allowing to (de)serialize
	  strings according to duplicate and / or copy strategies.

config DPACK_STRING_MAXLEN
	int "Maximum strings length"
	default 4095
	depends on DPACK_STRING
	help
	  Enforce a maximum length over strings excluding the terminating NULL
	  byte.

config DPACK_LVSTR
	bool "Length-Value strings"
	select DPACK_STRING
	default y
	help
          Build dpack library with length-value string support allowing to
          (de)serialize strings into Stroll's lvstr objects. lvstr objects are
	  Length-Value strings that make the management of strings life-cycle
	  easier.

config DPACK_BIN
	bool "Bins"
	default n
	help
          Build dpack library with MessagePack bin support allowing to
	  (de)serialize byte arrays / binary blobs according to duplicate and /
	  or copy strategies.

config DPACK_ARRAY
	bool "Arrays"
	default y
	help
          Build dpack library with MessagePack array support allowing to
	  (de)serialize lists of objects.

config DPACK_MAP
	bool "Maps"
	select DPACK_SCALAR
	default y
	help
          Build dpack library with MessagePack map support allowing to
	  (de)serialize structured aggregates of objects.

config DPACK_UTEST
	bool "Unit tests"
	default n
	help
	  Build dpack library unit testsuite.

config DPACK_VALGRIND
	bool "Valgrind support"
	depends on DPACK_UTEST
	default n
	help
	  Build dpack library unit test suite with Valgrind support enabled.
	  For debugging purposes only: do not use in production.

config DPACK_SAMPLE
	bool "Examples"
	select DPACK_MAP
	select DPACK_ARRAY
	select DPACK_STRING
	select DPACK_LVSTR
	select DPACK_FLOAT
	default n
	help
	  Build dpack library code example binaries demonstrating basic usage.

# ex: ft=kconfig:
```
